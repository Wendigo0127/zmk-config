## boards/boboard/Kconfig.defconfig
```kconfig
# Copyright (c) 2022 The ZMK Contributors
# SPDX-License-Identifier: MIT

if SHIELD_BOBOARD_LEFT

config ZMK_KEYBOARD_NAME
    default "BOBOARD"
    
config ZMK_SPLIT_ROLE_CENTRAL
    default y

endif

if SHIELD_BOBOARD_LEFT || SHIELD_BOBOARD_RIGHT

config ZMK_SPLIT
    default y

endif
```

## boards/boboard/Kconfig.shield
```kconfig
# Copyright (c) 2022 The ZMK Contributors
# SPDX-License-Identifier: MIT

config SHIELD_BOBOARD_LEFT
    def_bool $(shields_list_contains,triboard_left)

config SHIELD_BOBOARD_RIGHT
    def_bool $(shields_list_contains,triboard_right)
```

## config/boards/shields/boboard/Kconfig.shield
```kconfig
# Copyright (c) 2022 The ZMK Contributors
# SPDX-License-Identifier: MIT

config SHIELD_BOBOARD_LEFT
    def_bool $(shields_list_contains,boboard_left)

config SHIELD_BOBOARD_RIGHT
    def_bool $(shields_list_contains,boboard_right)
```
