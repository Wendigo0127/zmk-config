## config/boards/shields/poboard/Kconfig.defconfig
```kconfig
# Copyright (c) 2022 The ZMK Contributors
# SPDX-License-Identifier: MIT

if SHIELD_POBOARD_LEFT

config ZMK_KEYBOARD_NAME
    default "POBOARD"
    
config ZMK_SPLIT_ROLE_CENTRAL
    default y

endif

if SHIELD_POBOARD_LEFT || SHIELD_POBOARD_RIGHT

config ZMK_SPLIT
    default y

endif
```

## config/boards/shields/poboard/Kconfig.shield
```kconfig
# Copyright (c) 2022 The ZMK Contributors
# SPDX-License-Identifier: MIT

config SHIELD_POBOARD_LEFT
    def_bool $(shields_list_contains,poboard_left)

config SHIELD_POBOARD_RIGHT
    def_bool $(shields_list_contains,poboard_right)
```
